/**
 ******************************************************************************
 * @file    ssd1306.c
 * @brief   SSD1306 128x64 I2C OLED driver
 *          Software I2C via soft_i2c.h, direct GDDRAM write (no framebuffer)
 *          Font: 5x7 ASCII (95 chars, 6px wide with spacer)
 ******************************************************************************
 */

#include "ssd1306.h"
#include "soft_i2c.h"
#include "font5x7.h"

/* ================================================================== */
/* 5x7 ASCII font table (0x20 space through 0x7E ~)                    */
/* Each glyph: 5 bytes, each byte = one column, LSB = top pixel        */
/* ================================================================== */

const uint8_t font5x7[FONT5X7_COUNT][5] = {
    { 0x00, 0x00, 0x00, 0x00, 0x00 }, /*   space 0x20 */
    { 0x00, 0x00, 0x5F, 0x00, 0x00 }, /* ! */
    { 0x00, 0x07, 0x00, 0x07, 0x00 }, /* " */
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    { 0x08, 0x04, 0x08, 0x10, 0x08 }, /* ~ 0x7E */
};

/* ================================================================== */
/* Internal helper: send data to SSD1306 via I2C                       */
/* ================================================================== */

/**
 * @brief  Write control byte + data bytes to SSD1306 in one I2C transaction
 * @param  ctrl: SSD1306_CMD_STREAM or SSD1306_DATA_STREAM
 * @param  data: pointer to data bytes
 * @param  len:  number of data bytes
 */
static void ssd1306_i2c_write(uint8_t ctrl, const uint8_t *data, uint16_t len)
{
    soft_i2c_start();
    soft_i2c_write_byte(SSD1306_I2C_ADDR_W);   /* slave address + W */
    soft_i2c_write_byte(ctrl);                   /* control byte */
    for (uint16_t i = 0; i < len; i++) {
        soft_i2c_write_byte(data[i]);
    }
    soft_i2c_stop();
}

/* ================================================================== */
/* Public API                                                         */
/* ================================================================== */

/**
 * @brief  Send a single command byte to SSD1306
 */
void ssd1306_command(uint8_t cmd)
{
    ssd1306_i2c_write(SSD1306_CMD_STREAM, &cmd, 1);
}

/**
 * @brief  Initialize SSD1306 128x64 OLED
 * @retval 0 on success
 *
 * Must be called after ~100ms VDD stabilization delay.
 * Sequence follows SSD1306 datasheet initialization flow.
 */
uint8_t ssd1306_init(void)
{
    /* Multi-byte init sequence */
    static const uint8_t init_seq[] = {
        0xAE,           /* Display OFF */
        0xD5, 0x80,     /* Set osc freq / clock divider */
        0xA8, 0x3F,     /* Set multiplex ratio = 63 (height-1) */
        0xD3, 0x00,     /* Set display offset = 0 */
        0x40,           /* Set display start line = 0 */
        0x8D, 0x14,     /* Enable charge pump regulator (0x14 = internal DC/DC) */
        0x20, 0x00,     /* Memory addressing mode = horizontal */
        0xA1,           /* Segment remap: column 127 = SEG0 (flip horizontal) */
        0xC8,           /* COM output scan: remapped (flip vertical) */
        0xDA, 0x12,     /* COM pins hardware configuration */
        0x81, 0xCF,     /* Contrast = 0xCF */
        0xD9, 0xF1,     /* Pre-charge period */
        0xDB, 0x40,     /* VCOMH deselect level */
        0xA4,           /* Resume to RAM content (not all-on) */
        0xA6,           /* Normal display (not inverted) */
        0x2E,           /* Deactivate scrolling */
        0xAF,           /* Display ON */
    };

    for (uint16_t i = 0; i < sizeof(init_seq); i++) {
        ssd1306_command(init_seq[i]);
    }
    return 0;
}

/**
 * @brief  Set cursor position (page = row/8, col = pixel column)
 */
void ssd1306_set_cursor(uint8_t page, uint8_t col)
{
    ssd1306_command(0xB0 | (page & 0x07));           /* Set page address (0xB0~0xB7) */
    ssd1306_command(0x00 | (col & 0x0F));             /* Set lower column start address */
    ssd1306_command(0x10 | ((col >> 4) & 0x0F));      /* Set higher column start address */
}

/**
 * @brief  Clear entire screen (fill all 8 pages with zeros)
 */
void ssd1306_clear(void)
{
    for (uint8_t page = 0; page < SSD1306_PAGES; page++) {
        ssd1306_set_cursor(page, 0);
        /* Write 128 zero bytes in one transaction */
        soft_i2c_start();
        soft_i2c_write_byte(SSD1306_I2C_ADDR_W);
        soft_i2c_write_byte(SSD1306_DATA_STREAM);
        for (uint8_t i = 0; i < 128; i++) {
            soft_i2c_write_byte(0x00);
        }
        soft_i2c_stop();
    }
}

/**
 * @brief  Write one ASCII character at current cursor position (5x7 font)
 * @param  c: ASCII character (0x20-0x7E)
 *
 * Writes 6 columns: 5 font columns + 1 zero column (inter-char spacing).
 * Cursor auto-advances horizontally (SSD1306 horizontal addressing mode).
 */
void ssd1306_write_char(char c)
{
    uint8_t idx;

    /* Replace non-printable characters with space */
    if ((uint8_t)c < FONT5X7_START || (uint8_t)c > FONT5X7_END) {
        c = ' ';
    }
    idx = (uint8_t)c - FONT5X7_START;

    /* Write 5 font columns + 1 spacer column as data */
    soft_i2c_start();
    soft_i2c_write_byte(SSD1306_I2C_ADDR_W);
    soft_i2c_write_byte(SSD1306_DATA_STREAM);
    for (uint8_t col = 0; col < 5; col++) {
        soft_i2c_write_byte(font5x7[idx][col]);
    }
    soft_i2c_write_byte(0x00);   /* 1-pixel inter-character spacing */
    soft_i2c_stop();
}

/**
 * @brief  Write a null-terminated string at current cursor position
 * @param  str: ASCII string
 */
void ssd1306_write_string(const char *str)
{
    while (*str != '\0') {
        ssd1306_write_char(*str);
        str++;
    }
}
